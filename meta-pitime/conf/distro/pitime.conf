## meta-pitime/conf/distro/pitime.conf
```bitbake
DISTRO = "pitime"
DISTRO_NAME = "Pi Time (Raspberry Pi Clock)"
DISTRO_VERSION = "1.0.0"
DISTRO_CODENAME = "chrono"
SDK_VENDOR = "-pitimesdk"
SDK_VERSION = "${@d.getVar('DISTRO_VERSION').replace('snapshot-${DATE}', 'snapshot')}"

MAINTAINER = "Robert Joslyn <robert.joslyn@redrectangle.org>"

TARGET_VENDOR = "-pitime"

LOCALCONF_VERSION = "2"

DISTRO_VERSION[vardepsexclude] = "DATE"
SDK_VERSION[vardepsexclude] = "DATE"

# Override these in pitime based distros
PITIME_DEFAULT_DISTRO_FEATURES = " \
    acl \
    ipv4 \
    ipv6 \
    largefile \
    ptest \
    usbhost \
    wifi \
    seccomp \
    vfat \
    xattr \
"
PITIME_DEFAULT_EXTRA_RDEPENDS = "packagegroup-core-boot"
PITIME_DEFAULT_EXTRA_RRECOMMENDS = "kernel-module-af-packet"

DISTRO_FEATURES ?= "${PITIME_DEFAULT_DISTRO_FEATURES}"

INIT_MANAGER = "systemd"

PREFERRED_VERSION_linux-yocto ?= "5.15%"
PREFERRED_VERSION_linux-raspberrypi ?= "5.15%"

SDK_NAME = "${DISTRO}-${TCLIBC}-${SDKMACHINE}-${IMAGE_BASENAME}-${TUNE_PKGARCH}-${MACHINE}"
SDKPATHINSTALL = "/opt/${DISTRO}/${SDK_VERSION}"

DISTRO_EXTRA_RDEPENDS += " ${PITIME_DEFAULT_EXTRA_RDEPENDS}"
DISTRO_EXTRA_RRECOMMENDS += " ${PITIME_DEFAULT_EXTRA_RRECOMMENDS}"

TCLIBCAPPEND = ""

SANITY_TESTED_DISTROS ?= " \
            poky-3.3 \n \
            poky-3.4 \n \
            ubuntu-16.04 \n \
            ubuntu-18.04 \n \
            ubuntu-20.04 \n \
            ubuntu-21.10 \n \
            ubuntu-22.04 \n \
            fedora-34 \n \
            fedora-35 \n \
            fedora-36 \n \
            centos-7 \n \
            centos-8 \n \
            debian-9 \n \
            debian-10 \n \
            debian-11 \n \
            opensuseleap-15.3 \n \
            almalinux-8.5 \n \
            almalinux-8.7 \n \
            "

# add poky sanity bbclass
INHERIT += "poky-sanity"

require conf/distro/include/poky-world-exclude.inc
require conf/distro/include/no-static-libs.inc
require conf/distro/include/yocto-uninative.inc
require conf/distro/include/security_flags.inc
INHERIT += "uninative"

BB_SIGNATURE_HANDLER ?= "OEEquivHash"
BB_HASHSERVE ??= "auto"
```

## meta-pitime/conf/layer.conf
```bitbake
# We have a conf and classes directory, add to BBPATH
BBPATH .= ":${LAYERDIR}"

# We have recipes-* directories, add to BBFILES
BBFILES += "${LAYERDIR}/recipes-*/*/*.bb \
            ${LAYERDIR}/recipes-*/*/*.bbappend"

BBFILE_COLLECTIONS += "meta-pitime"
BBFILE_PATTERN_meta-pitime = "^${LAYERDIR}/"
BBFILE_PRIORITY_meta-pitime = "6"

LAYERDEPENDS_meta-pitime = "core"
LAYERSERIES_COMPAT_meta-pitime = "kirkstone"
```
